
#include "ascii_1608.h"
#include "display.h"
#include "sys_err.h"

static const u8 ascii_1608[];

static const i2c_oled_font_t font_ascii_1608 = {
	.width = 8,
	.height = 16,
	.size = 95,
	.data = ascii_1608
};

/**
 * @brief Show an ascii character on the OLED display.
 * @note  The character will not be displayed if there is not enough space on the screen.
 * 
 * @param x X coordinate, in pixels, range 0 ~ (width - 1)
 * @param y Y coordinate in columns (1 column = 8 pixels), range 0 ~ (height / 8 - 1)
 * @param chr Character to display
 */
void oled_show_char(u8 row, u8 col, char chr)
{
	CHECK_FALSE_RET_VOID(chr >= ' ' && chr <= '~');
	i2c_oled_show_char(&oled, row, col, &font_ascii_1608, chr - ' ');
}

/**
 * @brief Show a string on the OLED display.
 * @note  The string will automatically wrap to the next line if it exceeds the screen width.
 * 
 * @param row y coordinate in rows (1 row = 8 pixels), range 0 ~ (height / 8 - 1)
 * @param col x coordinate in cols, range 0 ~ (width - 1)
 * @param str String to display
 */
void oled_show_string(u8 row, u8 col, const char *str)
{
	CHECK_FALSE_RET_VOID(str);
	CHECK_FALSE_RET_VOID(row < oled.y_size_in_row && col < oled.x_size_in_col);
	u16 font_x_size_in_col = font_ascii_1608.width;
	u16 font_y_size_in_row = font_ascii_1608.height / 8;

	while (*str)
	{
		if (col + font_x_size_in_col > oled.x_size_in_col)
		{
			col = 0;
			row += font_y_size_in_row;
			if (row + font_y_size_in_row > oled.y_size_in_row)
			{
				break;
			}
		}
		oled_show_char(row, col, *str++);
		col += font_x_size_in_col;
	}
}

/**
 * @brief OLED display an integer number on the screen.
 * 
 * @param row y coordinate in rows (1 row = 8 pixels), range 0 ~ (height / 8 - 1)
 * @param col x coordinate in cols, range 0 ~ (width - 1)
 * @param num integer number to display
 * @param len minimum length of the displayed number, if the number has fewer digits than this length,
 *            it will be padded with spaces or zeros on the left. If the number has more digits than this length,
 *            it will be displayed in full without truncation.
 * @param zero_pad whether to pad with zeros (true) or spaces (false) if the number has fewer digits than the specified length
 */
void oled_show_int(u8 row, u8 col, int num, u8 len, bool zero_pad)
{
	char str[12]; // max 10 digits for s32 + null terminator
	int res;
	int print_len = min(len, sizeof(str) - 1); // limit length to 11 to avoid buffer overflow
	if (zero_pad) {
		res = snprintf(str, sizeof(str), "%0*d", print_len, num); // zero-pad the number to the specified length
	}
	else {
		res = snprintf(str, sizeof(str), "%*d", print_len, num); // space-pad the number to the specified length
	}
	CHECK_FALSE_RET_VOID(res > 0 && res < sizeof(str)); // check for encoding errors and buffer overflow
	oled_show_string(row, col, str);
}

#if 0
/**
 * @brief OLED display a floating-point number on the screen.
 * 
 * @param row x coordinate in columns (1 column = 8 pixels), range 0 ~ (height / 8 - 1)
 * @param col y coordinate in pixels, range 0 ~ (width - 1)
 * @param num floating-point number to display
 * @param int_len length of the integer part
 * @param frac_len length of the fractional part
 * @param zero_pad whether to pad with zeros (true) or spaces (false) if the number has fewer digits than the specified length
 */
void oled_show_float(u8 row, u8 col, float num, u8 int_len, u8 frac_len, bool zero_pad)
{
	char str[32]; // enough to hold the formatted float
	int res;
	if (zero_pad) {
		res = snprintf(str, sizeof(str), "%0*.*f", int_len + frac_len + 1, frac_len, num); // zero-pad the number
	}
	else {
		res = snprintf(str, sizeof(str), "%*.*f", int_len + frac_len + 1, frac_len, num); // space-pad the number
	}
	CHECK_FALSE_RET_VOID(res > 0 && res < sizeof(str)); // check for encoding errors and buffer overflow
	oled_show_string(row, col, str);
}
#endif

/* font 16x16 */
/* '`' is replaced with the degree sign. */
static const u8 ascii_1608[]=
{
	0x00,0x00,0x00,0x00,0x00,0x00,0x00,0x00,
	0x00,0x00,0x00,0x00,0x00,0x00,0x00,0x00,//  0
	
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	0x00,0x00,0x00,0x00,0x00,0x00,0x00,0x00,//~ 94
};
