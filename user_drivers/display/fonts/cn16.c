
#include "cn16.h"
#include "sys_err.h"
#include "display.h"

// The order of characters in this string should match the order of the corresponding font data in the cn16 array.
static const char cn16_cnchar[] = "闹钟日历秒表计时器";
static const u8 cn16[];

static const i2c_oled_font_t font_cn16 = {
    .width = 16,
    .height = 16,
    .size = 9, // each character takes 32 bytes (16x16 pixels)
    .data = cn16
};

/**
 * @brief Show a string of Chinese characters on the OLED display using the cn16 font.
 * @note  Each character should be encoded in UTF-8 and take 3 bytes.
 * 
 * @param row y coordinate in rows (1 row = 8 pixels), range 0 ~ (height / 8 - 1)
 * @param col x coordinate in cols, range 0 ~ (width - 1)
 * @param str String of Chinese characters to display
 */
void oled_show_cn16_str(u8 row, u8 col, char const *str)
{
    CHECK_FALSE_RET_VOID(str);
    CHECK_FALSE_RET_VOID(row < oled.y_size_in_row && col < oled.x_size_in_col);
    u16 font_x_size_in_col = font_cn16.width;
    u16 font_y_size_in_row = font_cn16.height / 8;

    while (*str)
    {
        // Find the index of the current character in the cnchar string
        const char *ptr = cn16_cnchar;
        int index = 0;
        while (*ptr)
        {
            if (strncmp(ptr, str, 3) == 0) // compare 3 bytes for UTF-8 character
            {
                break;
            }
            ptr += 3; // move to the next character (3 bytes for UTF-8)
            index++;
        }
        CHECK_FALSE_RET_VOID(*ptr); // character not found in cnchar string

        if (col + font_x_size_in_col > oled.x_size_in_col)
        {
            col = 0;
            row += font_y_size_in_row;
            if (row + font_y_size_in_row > oled.y_size_in_row)
            {
                break;
            }
        }
        i2c_oled_show_char(&oled, row, col, &font_cn16, index);
        col += font_x_size_in_col;
        str += 3; // move to the next UTF-8 character (3 bytes)
    }
}

static const u8 cn16[] =
{
    0x00,0xF8,0x01,0x22,0x20,0x22,0x2A,0xF2,0x22,0x22,0x22,0x22,0x02,0xFE,0x00,0x00,
    0x00,0xFF,0x00,0x00,0x1F,0x01,0x01,0x7F,0x09,0x11,0x0F,0x40,0x80,0x7F,0x00,0x00, /*'闹',0*/
    
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    0x08,0x08,0xF4,0x94,0x92,0x92,0xF1,0x00,0x01,0xF2,0x92,0x94,0x94,0xF8,0x08,0x00, /*'器',8*/
};
